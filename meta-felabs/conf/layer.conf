## meta-felabs/conf/layer.conf
```bitbake
# We have a conf and classes directory, add to BBPATH
BBPATH .= ":${LAYERDIR}"

# We have recipes-* directories, add to BBFILES
BBFILES += "${LAYERDIR}/recipes-*/*/*.bb \
	${LAYERDIR}/recipes-*/*/*.bbappend"

BBFILE_COLLECTIONS += "felabs"
BBFILE_PATTERN_felabs = "^${LAYERDIR}/"
BBFILE_PRIORITY_felabs = "7"

LAYERDEPENDS_felabs = "core"
IMAGE_INSTALL += "ncurses ninvaders"
```
